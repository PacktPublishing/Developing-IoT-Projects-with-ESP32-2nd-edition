## ch10/tflite_ex/sdkconfig.defaults
```kconfig
CONFIG_IDF_TARGET="esp32s3"
CONFIG_IDF_TARGET_ESP32S3=y
CONFIG_ESPTOOLPY_FLASHSIZE_8MB=y

CONFIG_LV_COLOR_DEPTH_16=y
CONFIG_LV_COLOR_DEPTH=16
CONFIG_LV_COLOR_16_SWAP=y
CONFIG_LV_FONT_MONTSERRAT_32=y

CONFIG_NN_ANSI_C=y
CONFIG_NN_OPTIMIZATIONS=0
```

## ch3/audio_ex/sdkconfig.defaults
```kconfig
CONFIG_IDF_TARGET="esp32s3"
CONFIG_ESPTOOLPY_FLASHMODE_QIO=y
CONFIG_ESPTOOLPY_FLASHSIZE_16MB=y
# CONFIG_ESPTOOLPY_FLASHSIZE_DETECT is not set
CONFIG_PARTITION_TABLE_CUSTOM=y

CONFIG_ESP32S3_DEFAULT_CPU_FREQ_240=y
CONFIG_ESP32S3_INSTRUCTION_CACHE_32KB=y
CONFIG_ESP32S3_DATA_CACHE_64KB=y
CONFIG_ESP32S3_DATA_CACHE_LINE_64B=y
CONFIG_ESP32S3_SPIRAM_SUPPORT=y
CONFIG_SPIRAM_MODE_OCT=y
CONFIG_SPIRAM_SPEED_80M=y
CONFIG_SPIRAM_MALLOC_ALWAYSINTERNAL=1024
CONFIG_SPIRAM_TRY_ALLOCATE_WIFI_LWIP=y
CONFIG_SPIRAM_MALLOC_RESERVE_INTERNAL=8192
#CONFIG_ESP_SYSTEM_PANIC_PRINT_HALT=y
CONFIG_ESP_CONSOLE_USB_SERIAL_JTAG=y
#CONFIG_ESP_CONSOLE_SECONDARY_NONE=y
CONFIG_ESP_TASK_WDT_TIMEOUT_S=7

#
# IPC (Inter-Processor Call)
#
CONFIG_ESP_IPC_TASK_STACK_SIZE=2048

# Wi-Fi
CONFIG_ESP32_WIFI_STATIC_RX_BUFFER_NUM=4
CONFIG_ESP32_WIFI_DYNAMIC_RX_BUFFER_NUM=4
CONFIG_ESP32_WIFI_STATIC_TX_BUFFER_NUM=4
CONFIG_ESP32_WIFI_CACHE_TX_BUFFER_NUM=16
CONFIG_ESP32_WIFI_TX_BA_WIN=4
CONFIG_ESP32_WIFI_RX_BA_WIN=4
CONFIG_ESP32_WIFI_AMSDU_TX_ENABLED=y
CONFIG_ESP32_WIFI_AMPDU_TX_ENABLED=n
CONFIG_ESP32_WIFI_AMPDU_TX_ENABLED=n

CONFIG_FREERTOS_VTASKLIST_INCLUDE_COREID=y
CONFIG_FREERTOS_GENERATE_RUN_TIME_STATS=y

CONFIG_MBEDTLS_EXTERNAL_MEM_ALLOC=y
CONFIG_BUTTON_SHORT_PRESS_TIME_MS=100
CONFIG_BUTTON_LONG_PRESS_TIME_MS=5000
CONFIG_ADC_BUTTON_MAX_BUTTON_PER_CHANNEL=4
CONFIG_IO_GLITCH_FILTER_TIME_MS=20

# Newlib
CONFIG_NEWLIB_NANO_FORMAT=y

CONFIG_FREERTOS_HZ=1000
CONFIG_FREERTOS_ENABLE_TASK_SNAPSHOT=n
CONFIG_FREERTOS_PLACE_FUNCTIONS_INTO_FLASH=y

# LWIP
CONFIG_LWIP_IPV6=n
CONFIG_LWIP_DHCPS=n
CONFIG_LWIP_ICMP=n

# ESP NETIF Adapter
CONFIG_ESP_NETIF_TCPIP_ADAPTER_COMPATIBLE_LAYER=n

# Common ESP-related
CONFIG_ESP_ERR_TO_NAME_LOOKUP=n

# ESP-MQTT Configurations
CONFIG_MQTT_TRANSPORT_WEBSOCKET=n

# Temporary Fix for Timer Overflows
CONFIG_FREERTOS_TIMER_TASK_STACK_DEPTH=3120

# SPIFFS
CONFIG_BSP_SPIFFS_FORMAT_ON_MOUNT_FAIL=y
CONFIG_BSP_SPIFFS_MOUNT_POINT="/spiffs"
CONFIG_BSP_SPIFFS_PARTITION_LABEL="storage"
CONFIG_BSP_SPIFFS_MAX_FILES=5

CONFIG_BSP_BOARD_ESP32_S3_BOX_3=y
```

## ch3/i2c_ex/sdkconfig.defaults
```kconfig
CONFIG_IDF_TARGET_ESP32S3=y
CONFIG_IDF_TARGET="esp32s3"

CONFIG_ESPTOOLPY_FLASHSIZE_16MB=y
CONFIG_ESPTOOLPY_FLASHSIZE="16MB"
CONFIG_ESP_GDBSTUB_ENABLED=y
CONFIG_ESP_GDBSTUB_SUPPORT_TASKS=y
CONFIG_ESP_GDBSTUB_MAX_TASKS=32
CONFIG_ESP_SYSTEM_PANIC_GDBSTUB=y
CONFIG_GDBSTUB_SUPPORT_TASKS=y
CONFIG_GDBSTUB_MAX_TASKS=32
CONFIG_ESP32S3_PANIC_GDBSTUB=y
```

## ch6/common/esp32c3_devkit_bsp/Kconfig
```kconfig
menu "ESP32-C3 Devkit M1 config"
	menu "GPIO Button"
	    config IO_GLITCH_FILTER_TIME_MS
	        int "IO glitch filter timer ms (10~100)"
	        range 10 100
	        default 50
	endmenu
	
	menu "WS2812 RGB LED"
	
	    config WS2812_LED_ENABLE
	        bool "Enable RGB LED"
	        default y
	        help
	            Disable the WS2812 RGB LED.
	
	    config WS2812_LED_GPIO
	        int "WS2812 LED GPIO"
	        default 8
	        depends on WS2812_LED_ENABLE
	        help
	            Set the WS2812 RGB LED GPIO.
	
	endmenu
endmenu
```

## ch6/mqtt_ex/main/Kconfig.projbuild
```kconfig
menu "Application settings"

    config MQTT_BROKER_IP
        string "IP of the MQTT broker to connect to"
        default "10.1.1.10"
        help
            The local network IP of the machine where you run MQTT broker

    config MQTT_PORT
        int "Port of the MQTT broker in use"
        default 1883
        help
            In general, port 1883 is for plaintext MQTT connections (no encryption).

    config MQTT_CLIENT_IDENTIFIER
        string "The MQTT client identifier used in this example"
        default "sensor-0"
        help
            The MQTT client identifier used in this example. Each client identifier must be unique.
    
endmenu
```

## ch6/mqtt_ex/sdkconfig.defaults
```kconfig
CONFIG_IDF_TARGET="esp32c3"
CONFIG_IDF_TARGET_ESP32C3=y
CONFIG_ESPTOOLPY_FLASHSIZE_4MB=y
CONFIG_FREERTOS_TIMER_TASK_STACK_DEPTH=3120
CONFIG_BT_ENABLED=y
CONFIG_BTDM_CTRL_MODE_BLE_ONLY=y
CONFIG_BT_NIMBLE_ENABLED=y
CONFIG_PARTITION_TABLE_CUSTOM=y
CONFIG_PARTITION_TABLE_CUSTOM_FILENAME="partitions.csv"
```

## ch6/prov_ex/main/Kconfig.projbuild
```kconfig
menu "Application settings"
    choice PROV_METHOD
        prompt "Provisioning method"
        default PROV_METHOD_SOFTAP
        help
            Provisioning method to add a WiFi network
        config PROV_METHOD_SOFTAP
            bool "softap"
        config PROV_METHOD_BLE
            bool "ble"
    endchoice
    
    config PROV_METHOD
        int
        default 1 if PROV_METHOD_BLE
        default 0
endmenu
```

## ch6/rest_client_ex/main/Kconfig.projbuild
```kconfig
menu "Application settings"

    config REST_SERVER_IP
        string "IP of the RESTful server"
        default "10.1.1.10"
        help
            The local network IP of the machine where you run RESTful server

    config REST_SERVER_PORT
        int "Port of the server in use"
        default 5000
        help
            The port of the RESTful server.
   
endmenu
```

## ch6/wifi_ex/sdkconfig.defaults
```kconfig
CONFIG_IDF_TARGET="esp32c3"
CONFIG_IDF_TARGET_ESP32C3=y
CONFIG_ESPTOOLPY_FLASHSIZE_4MB=y
CONFIG_FREERTOS_TIMER_TASK_STACK_DEPTH=3120
```

## ch7/ota_http_ex/main/Kconfig.projbuild
```kconfig
menu "Application settings"

    config FILE_SERVER_IP
        string "IP of the file server"
        default "10.1.1.10"
        help
            The local network IP of the machine where you run the file server

    config FILE_SERVER_PORT
        string "Port of the server in use"
        default "5000"
        help
            The port of the file server.
   
endmenu
```

## ch8/aws_ex/sdkconfig.defaults
```kconfig
CONFIG_IDF_TARGET="esp32c3"
CONFIG_IDF_TARGET_ESP32C3=y
CONFIG_ESPTOOLPY_FLASHSIZE_4MB=y
CONFIG_FREERTOS_TIMER_TASK_STACK_DEPTH=3120

CONFIG_NEWLIB_ENABLE=y
CONFIG_NEWLIB_LIBRARY_LEVEL_NORMAL=y
CONFIG_NEWLIB_NANO_FORMAT=
CONFIG_SSL_USING_MBEDTLS=y
CONFIG_LWIP_IPV6=y
CONFIG_PARTITION_TABLE_CUSTOM=y
CONFIG_PARTITION_TABLE_CUSTOM_FILENAME="partitions.csv"
CONFIG_PARTITION_TABLE_FILENAME="partitions.csv"
```

## ch9/plug/sdkconfig.defaults
```kconfig
CONFIG_IDF_TARGET="esp32c3"
CONFIG_IDF_TARGET_ESP32C3=y

CONFIG_ESPTOOLPY_FLASHSIZE_4MB=y
CONFIG_PARTITION_TABLE_CUSTOM=y
CONFIG_PARTITION_TABLE_CUSTOM_FILENAME="partitions.csv"
CONFIG_PARTITION_TABLE_FILENAME="partitions.csv"
CONFIG_PARTITION_TABLE_OFFSET=0x8000
CONFIG_PARTITION_TABLE_MD5=y

CONFIG_MBEDTLS_DYNAMIC_BUFFER=y
CONFIG_MBEDTLS_DYNAMIC_FREE_PEER_CERT=y
CONFIG_MBEDTLS_DYNAMIC_FREE_CONFIG_DATA=y
CONFIG_MBEDTLS_CERTIFICATE_BUNDLE_DEFAULT_CMN=y

CONFIG_BT_ENABLED=y
CONFIG_BTDM_CTRL_MODE_BLE_ONLY=y
CONFIG_BT_NIMBLE_ENABLED=y

CONFIG_FREERTOS_TIMER_TASK_STACK_DEPTH=3120

CONFIG_ESP_INSIGHTS_ENABLED=y
CONFIG_ESP_RMAKER_DEF_TIMEZONE="Europe/London"
CONFIG_ESP_RMAKER_MQTT_USE_BASIC_INGEST_TOPICS=n
CONFIG_ESP_RMAKER_LOCAL_CTRL_ENABLE=y
CONFIG_ESP_RMAKER_LOCAL_CTRL_SECURITY_1=y

WS2812_LED_ENABLE=y
```

## ch9/sensor/sdkconfig.defaults
```kconfig
CONFIG_IDF_TARGET="esp32s3"
CONFIG_IDF_TARGET_ESP32S3=y

CONFIG_ESPTOOLPY_FLASHSIZE_8MB=y
CONFIG_PARTITION_TABLE_CUSTOM=y
CONFIG_PARTITION_TABLE_CUSTOM_FILENAME="partitions.csv"
CONFIG_PARTITION_TABLE_FILENAME="partitions.csv"
CONFIG_PARTITION_TABLE_OFFSET=0x8000
CONFIG_PARTITION_TABLE_MD5=y

CONFIG_MBEDTLS_DYNAMIC_BUFFER=y
CONFIG_MBEDTLS_DYNAMIC_FREE_PEER_CERT=y
CONFIG_MBEDTLS_DYNAMIC_FREE_CONFIG_DATA=y
CONFIG_MBEDTLS_CERTIFICATE_BUNDLE_DEFAULT_CMN=y

CONFIG_BT_ENABLED=y
CONFIG_BTDM_CTRL_MODE_BLE_ONLY=y
CONFIG_BT_NIMBLE_ENABLED=y

CONFIG_FREERTOS_TIMER_TASK_STACK_DEPTH=3120

CONFIG_ESP_INSIGHTS_ENABLED=y
CONFIG_ESP_RMAKER_DEF_TIMEZONE="Europe/London"
CONFIG_ESP_RMAKER_MQTT_USE_BASIC_INGEST_TOPICS=n
CONFIG_ESP_RMAKER_LOCAL_CTRL_ENABLE=y
CONFIG_ESP_RMAKER_LOCAL_CTRL_SECURITY_1=y

CONFIG_LV_COLOR_DEPTH_16=y
CONFIG_LV_COLOR_DEPTH=16
CONFIG_LV_COLOR_16_SWAP=y
CONFIG_LV_FONT_MONTSERRAT_32=y
```

## components/esp-rainmaker/components/esp-insights/components/esp_diagnostics/Kconfig
```kconfig
menu "Diagnostics"
    choice DIAG_LOG_MSG_ARG_FORMAT
        prompt "Diagnostics log argument format"
        default DIAG_LOG_MSG_ARG_FORMAT_TLV
        help
            For error/warning/event logs, diagnostics module collects program counter, timestamp,
            tag, RO data pointer and log arguments. Log arguments are stored in statically allocated buffer.
            This option configures how to format and store log arguments in buffer.
            Log arguments can be formatted as TLV or complete log string formatted using vsnprintf.

            If "TLV" is selected, buffer contains arguments formatted as TLV.
            Type - 1 byte for the type of argument, please check esp_diag_arg_type_t.
            Length - 1 byte for the size of argument, size is calculated using sizeof operator.
            Value - Size bytes for the value.

            If "STRING" is selected, buffer contains the entire string formatted using vsnprintf.

        config DIAG_LOG_MSG_ARG_FORMAT_TLV
            bool "Format arguments as TLV"
        config DIAG_LOG_MSG_ARG_FORMAT_STRING
            bool "Format arguments as string"
    endchoice

    config DIAG_LOG_MSG_ARG_MAX_SIZE
        int "Maximum size of diagnostics log argument buffer"
        range 32 255
        default 64
        help
            Log arguments are stored in a static allocated buffer.
            This option configures the maximum size of buffer for storing log arguments.

    config DIAG_ENABLE_METRICS
        bool "Enable diagnostics metrics"
        default n
        help
            Diagnostics module supports recording and reporting metrics to cloud.
            This option enables the diagnostics metrics and related functionality.

    config DIAG_METRICS_MAX_COUNT
        depends on DIAG_ENABLE_METRICS
        int "Maximum number of metrics"
        default 20
        help
            This option configures the maximum number of metrics that can be registered.

    config DIAG_ENABLE_HEAP_METRICS
        depends on DIAG_ENABLE_METRICS
        bool "Enable Heap Metrics"
        default n
        help
            Enables the heap memory metrics. This collects free memory, largest free block,
            and minimum free memory for heaps in internal as well as external memory.

    config DIAG_ENABLE_WIFI_METRICS
        depends on DIAG_ENABLE_METRICS
        bool "Enable Wi-Fi Metrics"
        default n
        help
            Enables Wi-Fi metrics and collects Wi-Fi RSSI and minumum ever Wi-Fi RSSI.

    config DIAG_WIFI_RSSI_STEP_INTERVAL
        depends on DIAG_ENABLE_WIFI_METRICS
        int "Wi-Fi RSSI step interval"
        default 5
        range 5 20
        help
            RSSI is sampled every 30 seconds and if it crosses configured step interval in either direction
            then that value is reported to cloud. This option configures the step interval.

    config DIAG_ENABLE_VARIABLES
        bool "Enable diagnostics variables"
        default n
        help
            Variables are similar to metrics but they represent entities where their current value
            is much more important than over a period of time.
            This option enables the diagnostics variables and related functionality

    config DIAG_VARIABLES_MAX_COUNT
        depends on DIAG_ENABLE_VARIABLES
        int "Maximum number of variables"
        default 20
        help
            This option configures the maximum number of variables that can be registered.

    config DIAG_ENABLE_NETWORK_VARIABLES
        depends on DIAG_ENABLE_VARIABLES
        bool "Enable Network variables"
        default n
        help
            Enables the Wi-Fi and IP address variables. Below variables are collected.
            For Wi-Fi: SSID, BSSID, channel, auth mode, connection status, disconnection reason.
            For IP: IPv4 address, netmask, and gateway of the device.

endmenu
```

## components/esp-rainmaker/components/esp-insights/components/esp_insights/Kconfig
```kconfig
menu "ESP Insights"

    config ESP_INSIGHTS_ENABLED
        bool "Enable ESP Insights"
        default n

    config ESP_INSIGHTS_DEBUG_ENABLED
        depends on ESP_INSIGHTS_ENABLED
        bool "Enable Insights debug prints"
        default n

    config ESP_INSIGHTS_COREDUMP_ENABLE
        bool "Enable core dump summary support"
        default y
        depends on (ESP_COREDUMP_ENABLE_TO_FLASH && ESP_COREDUMP_DATA_FORMAT_ELF) || (ESP32_ENABLE_COREDUMP_TO_FLASH && ESP32_COREDUMP_DATA_FORMAT_ELF)
        help
            This option enables core dump summary functionality in insights.
            In case of crash, insights sends the core dump summary to cloud on next boot.

endmenu
```
